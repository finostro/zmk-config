## boards/shields/felipe_handwired/Kconfig.defconfig
```kconfig
# Copyright (c) 2022 The ZMK Contributors
# SPDX-License-Identifier: MIT

if SHIELD_FELIPE_HANDWIRED_LEFT

config ZMK_KEYBOARD_NAME
    default "Aurora Corne"

config ZMK_SPLIT_ROLE_CENTRAL
    default y

endif # SHIELD_FELIPE_HANDWIRED_LEFT

if SHIELD_FELIPE_HANDWIRED_LEFT || SHIELD_FELIPE_HANDWIRED_RIGHT

config ZMK_SPLIT
    default y




endif # SHIELD_FELIPE_HANDWIRED_LEFT || SHIELD_FELIPE_HANDWIRED_RIGHT
```

## boards/shields/felipe_handwired/Kconfig.shield
```kconfig
# Copyright (c) 2022 The ZMK Contributors
# SPDX-License-Identifier: MIT

config SHIELD_FELIPE_HANDWIRED_LEFT
    def_bool $(shields_list_contains,felipe_handwired_left)

config SHIELD_FELIPE_HANDWIRED_RIGHT
    def_bool $(shields_list_contains,felipe_handwired_right)
```
